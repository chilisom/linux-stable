/*
 * Copyright (C) 2015 Grinn - http://www.grinn-global.com
 * Grzegorz Glomb <g.glomb@grinn-global.com>
 *
 * This program is free software; you can redistribute it and/or modify
 * it under the terms of the GNU General Public License version 2 as
 * published by the Free Software Foundation.
 */

&am33xx_pinmux {
	pinctrl-names = "default";
	pinctrl-0 = <&unused_pins>;

	unused_pins: unused_pins {
		pinctrl-single,pins = <
			0x198 (PIN_INPUT | MUX_MODE7) /* "mcasp0_axr0.gpio3_16" */
			0x194 (PIN_INPUT | MUX_MODE7) /* "mcasp0_fsx.gpio3_15" */
			0x190 (PIN_INPUT | MUX_MODE7) /* "mcasp0_aclkx.gpio3_14" */
			0x1ac (PIN_INPUT | MUX_MODE7) /* "mcasp0_ahclkx.gpio3_21" */
			0x1a4 (PIN_INPUT | MUX_MODE7) /* "mcasp0_fsr.gpio3_19" */
			0x1a0 (PIN_INPUT | MUX_MODE7) /* "mcasp0_aclkr.gpio3_18" */
			0x19c (PIN_INPUT | MUX_MODE7) /* "mcasp0_ahclkr.gpio3_17" */
			0x1a8 (PIN_INPUT | MUX_MODE7) /* "mcasp0_axr1.gpio3_20" */
			0x1a4 (PIN_INPUT | MUX_MODE7) /* "mcasp0_fsr.gpio3_19" */
			0x150 (PIN_INPUT | MUX_MODE7) /* "spi0_sclk.gpio0_2" */
			0x15c (PIN_INPUT | MUX_MODE7) /* "spi0_cs0.gpio0_5" */
			0x158 (PIN_INPUT | MUX_MODE7) /* "spi0_d1.gpio0_4" */
			0x154 (PIN_INPUT | MUX_MODE7) /* "spi0_d0.gpio0_3" */
			0x164 (PIN_INPUT | MUX_MODE7) /* "ecap0_in_pwm0_out.gpio0_7" */
			0x17c (PIN_INPUT | MUX_MODE7) /* "uart1_rtsn.gpio0_13" */
			0x178 (PIN_INPUT | MUX_MODE7) /* "uart1_ctsn.gpio0_12" */
			0x184 (PIN_INPUT | MUX_MODE7) /* "uart1_txd.gpio0_15" */
			0x180 (PIN_INPUT | MUX_MODE7) /* "uart1_rxd.gpio0_14" */
			0x16c (PIN_INPUT | MUX_MODE7) /* "uart0_rtsn.gpio1_9" */
			0x168 (PIN_INPUT | MUX_MODE7) /* "uart0_ctsn.gpio1_8" */
			0x108 (PIN_INPUT | MUX_MODE7) /* "mii1_col.gpio3_0" */
			0x118 (PIN_INPUT | MUX_MODE7) /* "mii1_rxdv.gpio3_4" */
			0x11c (PIN_INPUT | MUX_MODE7) /* "mii1_txd3.gpio0_16" */
			0x120 (PIN_INPUT | MUX_MODE7) /* "mii1_txd2.gpio0_17" */
			0x12c (PIN_INPUT | MUX_MODE7) /* "mii1_txclk.gpio3_9" */
			0x134 (PIN_INPUT | MUX_MODE7) /* "mii1_rxd3.gpio2_18" */
			0x138 (PIN_INPUT | MUX_MODE7) /* "mii1_rxd2.gpio2_19" */
			0x130 (PIN_INPUT | MUX_MODE7) /* "mii1_rxclk.gpio3_10" */
			0x084 (PIN_INPUT | MUX_MODE7) /* "gpmc_csn2.gpio1_31" */
			0x088 (PIN_INPUT | MUX_MODE7) /* "gpmc_csn3.gpio2_0" */
			0x080 (PIN_INPUT | MUX_MODE7) /* "gpmc_csn1.gpio1_30" */
			0x078 (PIN_INPUT | MUX_MODE7) /* "gpmc_ben1.gpio1_28" */
			0x074 (PIN_INPUT | MUX_MODE7) /* "gpmc_wpn.gpio0_31" */
			0x068 (PIN_INPUT | MUX_MODE7) /* "gpmc_a10.gpio1_26" */
			0x06c (PIN_INPUT | MUX_MODE7) /* "gpmc_a11.gpio1_27" */
			0x060 (PIN_INPUT | MUX_MODE7) /* "gpmc_a8.gpio1_24" */
			0x064 (PIN_INPUT | MUX_MODE7) /* "gpmc_a9.gpio1_25" */
			0x058 (PIN_INPUT | MUX_MODE7) /* "gpmc_a6.gpio1_22" */
			0x05c (PIN_INPUT | MUX_MODE7) /* "gpmc_a7.gpio1_23" */
			0x050 (PIN_INPUT | MUX_MODE7) /* "gpmc_a4.gpio1_20" */
			0x054 (PIN_INPUT | MUX_MODE7) /* "gpmc_a5.gpio1_21" */
			0x048 (PIN_INPUT | MUX_MODE7) /* "gpmc_a2.gpio1_18" */
			0x04c (PIN_INPUT | MUX_MODE7) /* "gpmc_a3.gpio1_19" */
			0x040 (PIN_INPUT | MUX_MODE7) /* "gpmc_a0.gpio1_16" */
			0x044 (PIN_INPUT | MUX_MODE7) /* "gpmc_a1.gpio1_17" */
			0x03c (PIN_INPUT | MUX_MODE7) /* "gpmc_ad15.gpio1_15" */
			0x038 (PIN_INPUT | MUX_MODE7) /* "gpmc_ad14.gpio1_14" */
			0x034 (PIN_INPUT | MUX_MODE7) /* "gpmc_ad13.gpio1_13" */
			0x030 (PIN_INPUT | MUX_MODE7) /* "gpmc_ad12.gpio1_12" */
			0x02c (PIN_INPUT | MUX_MODE7) /* "gpmc_ad11.gpio0_27" */
			0x028 (PIN_INPUT | MUX_MODE7) /* "gpmc_ad10.gpio0_26" */
			0x024 (PIN_INPUT | MUX_MODE7) /* "gpmc_ad9.gpio0_23" */
			0x020 (PIN_INPUT | MUX_MODE7) /* "gpmc_ad8.gpio0_22" */
			0x08c (PIN_INPUT | MUX_MODE7) /* "gpmc_clk.gpio2_1" */
			0x0ec (PIN_INPUT | MUX_MODE7) /* "lcd_ac_bias_en.gpio2_25" */
			0x0e4 (PIN_INPUT | MUX_MODE7) /* "lcd_hsync.gpio2_23" */
			0x0e0 (PIN_INPUT | MUX_MODE7) /* "lcd_vsync.gpio2_22" */
			0x0e8 (PIN_INPUT | MUX_MODE7) /* "lcd_pclk.gpio2_24" */
			0x0dc (PIN_INPUT | MUX_MODE7) /* "lcd_data15.gpio0_11" */
			0x0d8 (PIN_INPUT | MUX_MODE7) /* "lcd_data14.gpio0_10" */
			0x0d4 (PIN_INPUT | MUX_MODE7) /* "lcd_data13.gpio0_9" */
			0x0d0 (PIN_INPUT | MUX_MODE7) /* "lcd_data12.gpio0_8" */
			0x0cc (PIN_INPUT | MUX_MODE7) /* "lcd_data11.gpio2_17" */
			0x0c8 (PIN_INPUT | MUX_MODE7) /* "lcd_data10.gpio2_16" */
			0x0c4 (PIN_INPUT | MUX_MODE7) /* "lcd_data9.gpio2_15" */
			0x0c0 (PIN_INPUT | MUX_MODE7) /* "lcd_data8.gpio2_14" */
			0x0bc (PIN_INPUT | MUX_MODE7) /* "lcd_data7.gpio2_13" */
			0x0b8 (PIN_INPUT | MUX_MODE7) /* "lcd_data6.gpio2_12" */
			0x0b4 (PIN_INPUT | MUX_MODE7) /* "lcd_data5.gpio2_11" */
			0x0b0 (PIN_INPUT | MUX_MODE7) /* "lcd_data4.gpio2_10" */
			0x0ac (PIN_INPUT | MUX_MODE7) /* "lcd_data3.gpio2_9" */
			0x0a8 (PIN_INPUT | MUX_MODE7) /* "lcd_data2.gpio2_8" */
			0x0a4 (PIN_INPUT | MUX_MODE7) /* "lcd_data1.gpio2_7" */
			0x0a0 (PIN_INPUT | MUX_MODE7) /* "lcd_data0.gpio2_6" */
		>;
	};
};
